## boards/arm/holyiot_yj_16048/Kconfig.board
```kconfig
# aW_1 board configuration
#
# Copyright (c) 2024 The ZMK Contributors
# SPDX-License-Identifier: MIT

config BOARD_HOLYIOT_YJ_16048
	bool "holyiot_yj_16048"
	depends on SOC_NRF52832_QFAA
```

## boards/shields/holyiot_yj_16048/boards/Kconfig.defconfig
```kconfig
# Copyright (c) 2024 The ZMK Contributors
# SPDX-License-Identifier: MIT

if BOARD_HOLYIOT_YJ_16048

config BOARD
    default "holyiot_yj_16048"

config ZMK_KEYBOARD_NAME
    default "holyiot_yj_16048"

config BT_CTLR
    default BT

#config ZMK_KSCAN_MATRIX_POLLING
#    default y

endif # BOARD_HOLYIOT_YJ_16048
```
